## common/drivers/amlogic/ch_audio/Kconfig
```kconfig
config AML_CH_AUDIO
	boolean "Amlogic CH_AUDIO drivers"
	default y
	---help---
		say yes if you want add Amlogic change audio support
```

## common/drivers/amlogic/ch_mic/Kconfig
```kconfig
config AML_CH_MIC
	boolean "Amlogic CH_MIC drivers"
	default y
	---help---
		say yes if you want add Amlogic change mic support
```

## common/drivers/amlogic/ctrl_mic/Kconfig
```kconfig
config AML_CTRL_MIC
	boolean "Amlogic AML_CTRL drivers"
	select  I2C
	default y
	---help---
		say yes if you want add Amlogic control mic support
```

## common/drivers/amlogic/gmd_13002/Kconfig
```kconfig
config AML_GMD_13002
	boolean "Amlogic GMD_13002 drivers"
	select  I2C
	default n
	---help---
		say yes if you want add Amlogic GMD support
```
